## conf/machine/beyonwizv2.conf
```bitbake
#@TYPE: Machine
#@NAME: beyonwizv2
#@DESCRIPTION: Machine configuration for the beyonwizv2

IMAGEDIR = "beyonwiz/v2"

EXTRA_OECONF_append_pn-enigma2 = "--with-lcddev=/dev/null --with-alphablendingacceleration=always --with-blitaccelerationthreshold=250  --with-fillaccelerationthreshold=190000"

MACHINE_FEATURES += "multitranscoding"

SOC_FAMILY = "hisi3798mv200"

require conf/machine/include/beyonwiz-hisi.inc

MACHINE_ESSENTIAL_EXTRA_RDEPENDS += "\
    enigma2-plugin-drivers-dvb-usb-it913x \
    enigma2-plugin-drivers-dvb-usb-rtl2832 \
    "
```
